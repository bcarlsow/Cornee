## config/west.yml
```yaml
manifest:
  defaults:
    revision: v0.3
  remotes:
    - name: myfork
      url-base: https://github.com/bcarlsow
    - name: zmkfirmware
      url-base: https://github.com/zmkfirmware
    - name: mctechnology17
      url-base: https://github.com/mctechnology17
  projects:
    - name: zmk
      remote: zmkfirmware
      import: app/west.yml
    - name: zmk-nice-oled
      remote: myfork
      revision: main
  self:
    path: config
```
